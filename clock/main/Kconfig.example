## clock/main/Kconfig.example
```kconfig
menu "CALclock"

    config OTA_UPDATE_FIRMWARE_URL
        string "Firmware upgrade url endpoint"
        default "http://host:80/path/to/clock.bin"
        help
            URL of server which hosts the firmware image. (make sure it matches Kconfig in factory dir)

    config OTA_UPDATE_RECV_TIMEOUT
        int "OTA Update receive Timeout"
        default 5000
        help
            Maximum time for reception [sec]

    config CALCLOCK_WS2812_PIN
        int "GPIO# to WS2812 DATA"
        default 18
        help
            Transmit GPIO pin on ESP32 that connects to DATA on the LED circle

    config CALCLOCK_WS2812_COUNT
        int "Number of LEDs"
        default 60
        help
            Number of WS2812 pixels on LED circle

    config CALCLOCK_GAS_CALENDAR_URL
        string "Google script uri"
        default "https://script.google.com/macros/s/YOUR_UNIQ_KEY/exec"
        help
            Public URL of the Google Apps script that supplies JSON of the
            calendar events.

    config CALCLOCK_HARDCODED_WIFI_CREDENTIALS
        bool "Use hardcoded Wi-Fi credentials"
        default n
        help
            Use a hardcoded Wi-Fi credentials. Defaults to n for BLE provisioning.
            
    config CALCLOCK_HARDCODED_WIFI_SSID
        string "WiFi SSID"
        default ""
        depends on CALCLOCK_HARDCODED_WIFI_CREDENTIALS
        help
            SSID (network name).

    config CALCLOCK_HARDCODED_WIFI_PASSWD
        string "WiFi Password"
        default ""
        depends on CALCLOCK_HARDCODED_WIFI_CREDENTIALS
        help
            WiFi password (WPA or WPA2).
        
endmenu
```

## clock/sdkconfig.defaults
```kconfig
# factory binary is larger than default size
CONFIG_PARTITION_TABLE_CUSTOM=y
CONFIG_PARTITION_TABLE_CUSTOM_FILENAME="../partitions.csv"
CONFIG_PARTITION_TABLE_FILENAME="../partitions.csv"

# need 4 MByte flash for OTA updates
CONFIG_ESPTOOLPY_FLASHSIZE_4MB=y

# prevent 431 status on httpd server
CONFIG_HTTPD_MAX_REQ_HDR_LEN=1024

# skip TLS certificate check
CONFIG_ESP_TLS_INSECURE=y
CONFIG_ESP_TLS_SKIP_SERVER_CERT_VERIFY=y
```
